## CMakeLists.txt
```
cmake_minimum_required(VERSION 3.20.0)
set(BOARD esp32_devkitc_wroom/esp32/procpu)
find_package(Zephyr REQUIRED HINTS $ENV{ZEPHYR_BASE})
project(hh0puck)

zephyr_include_directories(src)
target_sources(app PRIVATE src/main.c)
```

## west.yml
```
manifest:
  self:
    path: app
  remotes:
    - name: zephyrproject-rtos
      url-base: https://github.com/zephyrproject-rtos
  projects:
    - name: zephyr
      remote: zephyrproject-rtos
      revision: main
      import:
        name-allowlist:
          - zephyr
          - cmsis
          - hal_espressif
    - name: HX711
      path: modules/HX711
      revision: refs/tags/zephyr-v3.2.0
      url: https://github.com/nobodyguy/HX711_zephyr_driver
```

## prj.conf
```kconfig
CONFIG_PRINTK=y
CONFIG_STDOUT_CONSOLE=y

CONFIG_SENSOR=y
CONFIG_HX711=y
CONFIG_LOG=y
CONFIG_CBPRINTF_FP_SUPPORT=y

# CONFIG_BOOTLOADER_MCUBOOT=y
```

## boards/esp32_devkitc_esp32_procpu.overlay
```dts
/ {
	hx711 {
		compatible = "avia,hx711";
		status = "okay";
		label = "HX711";
		dout-gpios = <&gpio 27 GPIO_ACTIVE_HIGH>;
		sck-gpios = <&gpio 26 GPIO_ACTIVE_HIGH>;
	};
};
```

## src/main.c
```c
#include <zephyr/kernel.h>
#include <zephyr/device.h>
#include <zephyr/devicetree.h>
#include <zephyr/drivers/sensor.h>
#include <zephyr/logging/log.h>
#include <zephyr/sys/util.h>
#include <zephyr/types.h>

#include <sensor/hx711/hx711.h>
#include <stddef.h>

LOG_MODULE_REGISTER(main, LOG_LEVEL_INF);

const struct device *hx711_dev;
static struct sensor_value bottle_weight;
void set_rate(enum hx711_rate rate)
{
	static struct sensor_value rate_val;

	rate_val.val1 = rate;
	sensor_attr_set(hx711_dev,
			HX711_SENSOR_CHAN_WEIGHT,
			SENSOR_ATTR_SAMPLING_FREQUENCY,
			&rate_val);
}

void measure(void)
{
	static struct sensor_value weight;
	int ret;

	ret = sensor_sample_fetch(hx711_dev);
	if (ret != 0) {
		LOG_ERR("Cannot take measurement: %d", ret);
	} else {
		sensor_channel_get(hx711_dev, HX711_SENSOR_CHAN_WEIGHT, &weight);

		struct hx711_data *data = hx711_dev->data;
		LOG_INF("Weight: %d grams, ", weight.val1);
		double volume_l = (weight.val1 - bottle_weight.val1) / 1000.0;
		LOG_INF("Water Volume: %.3f L", volume_l);
	}
}

void measureBottleEmptyWeight(void)
{
	int ret;

	ret = sensor_sample_fetch(hx711_dev);
	if (ret != 0) {
		LOG_ERR("Cannot take measurement: %d", ret);
	} else {
		sensor_channel_get(hx711_dev, HX711_SENSOR_CHAN_WEIGHT, &bottle_weight);
		struct hx711_data *data = hx711_dev->data;
		LOG_INF("Bottle Weight: %d grams, ", bottle_weight.val1);
	}
}
void main(void)
{
	int calibration_weight = 1863; // grams
	hx711_dev = DEVICE_DT_GET_ANY(avia_hx711);
	__ASSERT(hx711_dev == NULL, "Failed to get device binding");

	LOG_INF("Device is %p, name is %s", hx711_dev, hx711_dev->name);
	LOG_INF("Calculating offset...");
	int offest =  avia_hx711_tare(hx711_dev, 40);

	LOG_INF("Waiting for known weight of %d grams...",
		calibration_weight);

	for (int i = 10; i >= 0; i--) {
		LOG_INF(" %d..", i);
		k_msleep(1000);
	}

	LOG_INF("Calculating slope...");
	struct sensor_value slope = avia_hx711_calibrate(hx711_dev, calibration_weight, 40);
	LOG_INF("Slope: %d.%06d Offest: %d", slope.val1, slope.val2, offest);

	LOG_INF("Remove Calibration weight...");
	for (int i = 10; i >= 0; i--) {
		LOG_INF(" %d..", i);
		k_msleep(1000);
	}
	avia_hx711_tare(hx711_dev, 40);

	LOG_INF("Add Bottle empty weight...");
	for (int i = 10; i >= 0; i--) {
		LOG_INF(" %d..", i);
		k_msleep(1000);
	}

	measureBottleEmptyWeight();

	while (true) {
		k_msleep(1000);
		LOG_INF("== Test measure ==");
		LOG_INF("= Setting sampling rate to 10Hz.");
		set_rate(HX711_RATE_10HZ);
		measure();

		k_msleep(1000);
		LOG_INF("= Setting sampling rate to 80Hz.");
		set_rate(HX711_RATE_80HZ);
		measure();
	}
}
```
