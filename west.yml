## west.yml
```yaml
manifest:
  self:
    west-commands: scripts/west-commands.yml

  projects:
    - name: zephyr
      url: https://github.com/zephyrproject-rtos/zephyr
      revision: refs/tags/zephyr-v3.2.0
      import:
        name-allowlist:
          - zephyr
          - cmsis
          - hal_espressif
    - name: HX711
      path: modules/HX711
      revision: refs/tags/zephyr-v3.2.0
      url: https://github.com/nobodyguy/HX711_zephyr_driver
```
